## zmk-config/boards/shields/aldrin/Kconfig.defconfig
```kconfig
if SHIELD_ALDRIN_LEFT

config ZMK_KEYBOARD_NAME
    default "Aldrin"

config ZMK_SPLIT_ROLE_CENTRAL
    default y

endif

if SHIELD_ALDRIN_LEFT || SHIELD_ALDRIN_RIGHT

config ZMK_SPLIT
    default y

endif
```

## zmk-config/boards/shields/aldrin/Kconfig.shield
```kconfig
config SHIELD_ALDRIN_LEFT
    def_bool $(shields_list_contains,aldrin_left)

config SHIELD_ALDRIN_RIGHT
    def_bool $(shields_list_contains,aldrin_right)
```
