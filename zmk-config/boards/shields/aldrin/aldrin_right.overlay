#include "aldrin.dtsi"

&default_transform { 
    col-offset = <7>;
};

// Mapped from nice!nano pins P017, P020, P022, P024, P100, P008, P006 (reversed)
// Pin mappings at https://youtu.be/7UXsD7nSfDY?si=QbZC2xl05s6fYf3I&t=1151
&kscan0 {
    col-gpios
        = <&pro_micro 1 GPIO_ACTIVE_HIGH>
        , <&pro_micro 0 GPIO_ACTIVE_HIGH>
        , <&pro_micro 6 GPIO_ACTIVE_HIGH>
        , <&pro_micro 5 GPIO_ACTIVE_HIGH>
        , <&pro_micro 4 GPIO_ACTIVE_HIGH>
        , <&pro_micro 3 GPIO_ACTIVE_HIGH>
        , <&pro_micro 2 GPIO_ACTIVE_HIGH>
        ;
};
